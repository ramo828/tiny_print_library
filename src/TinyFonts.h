/**
 * @file TinyFonts.h
 * @brief Font rendering tables and custom font definitions for X5H / Tiny Thermal Printers.
 * @author Ramiz Mammadli
 * @version 1.1.0
 * @date 2026-08-15
 * 
 * Supports standard 8x8 font with Unicode UTF-8 (Azerbaijani/Latin), compact 5x7 font,
 * medium 12x16 font, large 16x24 font, and customizable user font structures.
 */

#ifndef TINY_FONTS_H
#define TINY_FONTS_H

#include <Arduino.h>
#include <cstring>

/**
 * @brief Enum defining built-in font selections.
 */
enum FontType {
  FONT_8X8 = 0,    ///< Standard 8x8 monospace font (Latin + Azerbaijani UTF-8)
  FONT_5X7 = 1,    ///< Compact 5x7 micro receipt font
  FONT_12X16 = 2,  ///< Medium 12x16 header font
  FONT_16X24 = 3,  ///< Large 16x24 title font
  FONT_CUSTOM = 4  ///< User-defined custom bitmap font
};

/**
 * @brief Structure for an individual custom font character glyph bitmap.
 */
struct CustomGlyph {
  uint32_t codePoint;      ///< Character Unicode codepoint or ASCII code (e.g. 'A', 0x0259)
  uint8_t width;           ///< Glyph width in pixels
  uint8_t height;          ///< Glyph height in pixels
  const uint8_t* bitmap;   ///< Monochrome bit-packed byte array (1 bit per pixel, row-major)
};

/**
 * @brief Structure for a complete custom bitmap font.
 */
struct CustomFont {
  const char* name;          ///< Human-readable font name
  uint8_t defaultWidth;      ///< Base font width in pixels
  uint8_t defaultHeight;     ///< Base font height in pixels
  size_t glyphCount;         ///< Number of custom glyphs in array
  const CustomGlyph* glyphs; ///< Array of custom glyph definitions
};

// ============================================================
// 1. STANDARD 8x8 FONT (Latin + Azerbaijani UTF-8)
// ============================================================

/**
 * @brief Retrieve standard 8x8 ASCII font bitmap glyph.
 * @param c ASCII character.
 * @param glyph Output buffer of 8 bytes (8x8 bits).
 */
inline void x5hGetFontGlyph8x8(char c, uint8_t glyph[8]) {
  memset(glyph, 0, 8);
  switch (c) {
    // Digits
    case '0': { static const uint8_t g[] = {0x3C, 0x66, 0x6E, 0x76, 0x66, 0x66, 0x3C, 0x00}; memcpy(glyph, g, 8); break; }
    case '1': { static const uint8_t g[] = {0x18, 0x38, 0x18, 0x18, 0x18, 0x18, 0x7E, 0x00}; memcpy(glyph, g, 8); break; }
    case '2': { static const uint8_t g[] = {0x3C, 0x66, 0x0C, 0x18, 0x30, 0x60, 0x7E, 0x00}; memcpy(glyph, g, 8); break; }
    case '3': { static const uint8_t g[] = {0x3C, 0x66, 0x06, 0x1C, 0x06, 0x66, 0x3C, 0x00}; memcpy(glyph, g, 8); break; }
    case '4': { static const uint8_t g[] = {0x0C, 0x1C, 0x3C, 0x6C, 0x7E, 0x0C, 0x0C, 0x00}; memcpy(glyph, g, 8); break; }
    case '5': { static const uint8_t g[] = {0x7E, 0x60, 0x7C, 0x06, 0x06, 0x66, 0x3C, 0x00}; memcpy(glyph, g, 8); break; }
    case '6': { static const uint8_t g[] = {0x1C, 0x30, 0x60, 0x7C, 0x66, 0x66, 0x3C, 0x00}; memcpy(glyph, g, 8); break; }
    case '7': { static const uint8_t g[] = {0x7E, 0x06, 0x0C, 0x18, 0x30, 0x30, 0x30, 0x00}; memcpy(glyph, g, 8); break; }
    case '8': { static const uint8_t g[] = {0x3C, 0x66, 0x66, 0x3C, 0x66, 0x66, 0x3C, 0x00}; memcpy(glyph, g, 8); break; }
    case '9': { static const uint8_t g[] = {0x3C, 0x66, 0x66, 0x3E, 0x06, 0x0C, 0x38, 0x00}; memcpy(glyph, g, 8); break; }

    // Uppercase letters
    case 'A': { static const uint8_t g[] = {0x18, 0x3C, 0x66, 0x66, 0x7E, 0x66, 0x66, 0x00}; memcpy(glyph, g, 8); break; }
    case 'B': { static const uint8_t g[] = {0x7C, 0x66, 0x66, 0x7C, 0x66, 0x66, 0x7C, 0x00}; memcpy(glyph, g, 8); break; }
    case 'C': { static const uint8_t g[] = {0x3C, 0x66, 0x60, 0x60, 0x60, 0x66, 0x3C, 0x00}; memcpy(glyph, g, 8); break; }
    case 'D': { static const uint8_t g[] = {0x78, 0x6C, 0x66, 0x66, 0x66, 0x6C, 0x78, 0x00}; memcpy(glyph, g, 8); break; }
    case 'E': { static const uint8_t g[] = {0x7E, 0x60, 0x60, 0x7C, 0x60, 0x60, 0x7E, 0x00}; memcpy(glyph, g, 8); break; }
    case 'F': { static const uint8_t g[] = {0x7E, 0x60, 0x60, 0x7C, 0x60, 0x60, 0x60, 0x00}; memcpy(glyph, g, 8); break; }
    case 'G': { static const uint8_t g[] = {0x3C, 0x66, 0x60, 0x6E, 0x66, 0x66, 0x3C, 0x00}; memcpy(glyph, g, 8); break; }
    case 'H': { static const uint8_t g[] = {0x66, 0x66, 0x66, 0x7E, 0x66, 0x66, 0x66, 0x00}; memcpy(glyph, g, 8); break; }
    case 'I': { static const uint8_t g[] = {0x3C, 0x18, 0x18, 0x18, 0x18, 0x18, 0x3C, 0x00}; memcpy(glyph, g, 8); break; }
    case 'J': { static const uint8_t g[] = {0x1E, 0x0C, 0x0C, 0x0C, 0x0C, 0x6C, 0x38, 0x00}; memcpy(glyph, g, 8); break; }
    case 'K': { static const uint8_t g[] = {0x66, 0x6C, 0x78, 0x70, 0x78, 0x6C, 0x66, 0x00}; memcpy(glyph, g, 8); break; }
    case 'L': { static const uint8_t g[] = {0x60, 0x60, 0x60, 0x60, 0x60, 0x60, 0x7E, 0x00}; memcpy(glyph, g, 8); break; }
    case 'M': { static const uint8_t g[] = {0x63, 0x77, 0x7F, 0x6B, 0x63, 0x63, 0x63, 0x00}; memcpy(glyph, g, 8); break; }
    case 'N': { static const uint8_t g[] = {0x66, 0x76, 0x7E, 0x7E, 0x6E, 0x66, 0x66, 0x00}; memcpy(glyph, g, 8); break; }
    case 'O': { static const uint8_t g[] = {0x3C, 0x66, 0x66, 0x66, 0x66, 0x66, 0x3C, 0x00}; memcpy(glyph, g, 8); break; }
    case 'P': { static const uint8_t g[] = {0x7C, 0x66, 0x66, 0x7C, 0x60, 0x60, 0x60, 0x00}; memcpy(glyph, g, 8); break; }
    case 'Q': { static const uint8_t g[] = {0x3C, 0x66, 0x66, 0x66, 0x6A, 0x6C, 0x36, 0x00}; memcpy(glyph, g, 8); break; }
    case 'R': { static const uint8_t g[] = {0x7C, 0x66, 0x66, 0x7C, 0x6C, 0x66, 0x63, 0x00}; memcpy(glyph, g, 8); break; }
    case 'S': { static const uint8_t g[] = {0x3C, 0x66, 0x60, 0x3C, 0x06, 0x66, 0x3C, 0x00}; memcpy(glyph, g, 8); break; }
    case 'T': { static const uint8_t g[] = {0x7E, 0x18, 0x18, 0x18, 0x18, 0x18, 0x18, 0x00}; memcpy(glyph, g, 8); break; }
    case 'U': { static const uint8_t g[] = {0x66, 0x66, 0x66, 0x66, 0x66, 0x66, 0x3C, 0x00}; memcpy(glyph, g, 8); break; }
    case 'V': { static const uint8_t g[] = {0x66, 0x66, 0x66, 0x66, 0x66, 0x3C, 0x18, 0x00}; memcpy(glyph, g, 8); break; }
    case 'W': { static const uint8_t g[] = {0x63, 0x63, 0x63, 0x6B, 0x7F, 0x77, 0x63, 0x00}; memcpy(glyph, g, 8); break; }
    case 'X': { static const uint8_t g[] = {0x66, 0x66, 0x3C, 0x18, 0x3C, 0x66, 0x66, 0x00}; memcpy(glyph, g, 8); break; }
    case 'Y': { static const uint8_t g[] = {0x66, 0x66, 0x66, 0x3C, 0x18, 0x18, 0x18, 0x00}; memcpy(glyph, g, 8); break; }
    case 'Z': { static const uint8_t g[] = {0x7E, 0x06, 0x0C, 0x18, 0x30, 0x60, 0x7E, 0x00}; memcpy(glyph, g, 8); break; }

    // Lowercase letters
    case 'a': { static const uint8_t g[] = {0x00, 0x00, 0x3C, 0x06, 0x3E, 0x66, 0x3E, 0x00}; memcpy(glyph, g, 8); break; }
    case 'b': { static const uint8_t g[] = {0x60, 0x60, 0x7C, 0x66, 0x66, 0x66, 0x7C, 0x00}; memcpy(glyph, g, 8); break; }
    case 'c': { static const uint8_t g[] = {0x00, 0x00, 0x3C, 0x60, 0x60, 0x60, 0x3C, 0x00}; memcpy(glyph, g, 8); break; }
    case 'd': { static const uint8_t g[] = {0x06, 0x06, 0x3E, 0x66, 0x66, 0x66, 0x3E, 0x00}; memcpy(glyph, g, 8); break; }
    case 'e': { static const uint8_t g[] = {0x00, 0x00, 0x3C, 0x66, 0x7E, 0x60, 0x3C, 0x00}; memcpy(glyph, g, 8); break; }
    case 'f': { static const uint8_t g[] = {0x1C, 0x30, 0x30, 0x7C, 0x30, 0x30, 0x30, 0x00}; memcpy(glyph, g, 8); break; }
    case 'g': { static const uint8_t g[] = {0x00, 0x00, 0x3E, 0x66, 0x66, 0x3E, 0x06, 0x3C}; memcpy(glyph, g, 8); break; }
    case 'h': { static const uint8_t g[] = {0x60, 0x60, 0x7C, 0x66, 0x66, 0x66, 0x66, 0x00}; memcpy(glyph, g, 8); break; }
    case 'i': { static const uint8_t g[] = {0x18, 0x00, 0x38, 0x18, 0x18, 0x18, 0x3C, 0x00}; memcpy(glyph, g, 8); break; }
    case 'j': { static const uint8_t g[] = {0x0C, 0x00, 0x1C, 0x0C, 0x0C, 0x0C, 0x6C, 0x38}; memcpy(glyph, g, 8); break; }
    case 'k': { static const uint8_t g[] = {0x60, 0x60, 0x6C, 0x78, 0x70, 0x78, 0x6C, 0x00}; memcpy(glyph, g, 8); break; }
    case 'l': { static const uint8_t g[] = {0x38, 0x18, 0x18, 0x18, 0x18, 0x18, 0x3C, 0x00}; memcpy(glyph, g, 8); break; }
    case 'm': { static const uint8_t g[] = {0x00, 0x00, 0x66, 0x7F, 0x7F, 0x6B, 0x63, 0x00}; memcpy(glyph, g, 8); break; }
    case 'n': { static const uint8_t g[] = {0x00, 0x00, 0x7C, 0x66, 0x66, 0x66, 0x66, 0x00}; memcpy(glyph, g, 8); break; }
    case 'o': { static const uint8_t g[] = {0x00, 0x00, 0x3C, 0x66, 0x66, 0x66, 0x3C, 0x00}; memcpy(glyph, g, 8); break; }
    case 'p': { static const uint8_t g[] = {0x00, 0x00, 0x7C, 0x66, 0x66, 0x7C, 0x60, 0x60}; memcpy(glyph, g, 8); break; }
    case 'q': { static const uint8_t g[] = {0x00, 0x00, 0x3E, 0x66, 0x66, 0x3E, 0x06, 0x06}; memcpy(glyph, g, 8); break; }
    case 'r': { static const uint8_t g[] = {0x00, 0x00, 0x6C, 0x76, 0x60, 0x60, 0x60, 0x00}; memcpy(glyph, g, 8); break; }
    case 's': { static const uint8_t g[] = {0x00, 0x00, 0x3E, 0x60, 0x3C, 0x06, 0x7C, 0x00}; memcpy(glyph, g, 8); break; }
    case 't': { static const uint8_t g[] = {0x30, 0x30, 0x7C, 0x30, 0x30, 0x30, 0x1C, 0x00}; memcpy(glyph, g, 8); break; }
    case 'u': { static const uint8_t g[] = {0x00, 0x00, 0x66, 0x66, 0x66, 0x66, 0x3E, 0x00}; memcpy(glyph, g, 8); break; }
    case 'v': { static const uint8_t g[] = {0x00, 0x00, 0x66, 0x66, 0x66, 0x3C, 0x18, 0x00}; memcpy(glyph, g, 8); break; }
    case 'w': { static const uint8_t g[] = {0x00, 0x00, 0x63, 0x6B, 0x7F, 0x3E, 0x36, 0x00}; memcpy(glyph, g, 8); break; }
    case 'x': { static const uint8_t g[] = {0x00, 0x00, 0x66, 0x3C, 0x18, 0x3C, 0x66, 0x00}; memcpy(glyph, g, 8); break; }
    case 'y': { static const uint8_t g[] = {0x00, 0x00, 0x66, 0x66, 0x66, 0x3E, 0x06, 0x3C}; memcpy(glyph, g, 8); break; }
    case 'z': { static const uint8_t g[] = {0x00, 0x00, 0x7E, 0x0C, 0x18, 0x30, 0x7E, 0x00}; memcpy(glyph, g, 8); break; }

    // Punctuation & symbols
    case '!': { static const uint8_t g[] = {0x18, 0x3C, 0x3C, 0x18, 0x18, 0x00, 0x18, 0x00}; memcpy(glyph, g, 8); break; }
    case '?': { static const uint8_t g[] = {0x3C, 0x66, 0x06, 0x0C, 0x18, 0x00, 0x18, 0x00}; memcpy(glyph, g, 8); break; }
    case '.': { static const uint8_t g[] = {0x00, 0x00, 0x00, 0x00, 0x00, 0x18, 0x18, 0x00}; memcpy(glyph, g, 8); break; }
    case ',': { static const uint8_t g[] = {0x00, 0x00, 0x00, 0x00, 0x00, 0x18, 0x18, 0x30}; memcpy(glyph, g, 8); break; }
    case '-': { static const uint8_t g[] = {0x00, 0x00, 0x00, 0x7E, 0x00, 0x00, 0x00, 0x00}; memcpy(glyph, g, 8); break; }
    case ':': { static const uint8_t g[] = {0x00, 0x18, 0x18, 0x00, 0x00, 0x18, 0x18, 0x00}; memcpy(glyph, g, 8); break; }
    case ';': { static const uint8_t g[] = {0x00, 0x18, 0x18, 0x00, 0x00, 0x18, 0x18, 0x30}; memcpy(glyph, g, 8); break; }
    case '\'': { static const uint8_t g[] = {0x18, 0x18, 0x30, 0x00, 0x00, 0x00, 0x00, 0x00}; memcpy(glyph, g, 8); break; }
    case '"': { static const uint8_t g[] = {0x66, 0x66, 0x00, 0x00, 0x00, 0x00, 0x00, 0x00}; memcpy(glyph, g, 8); break; }
    case '(': { static const uint8_t g[] = {0x0C, 0x18, 0x30, 0x30, 0x30, 0x18, 0x0C, 0x00}; memcpy(glyph, g, 8); break; }
    case ')': { static const uint8_t g[] = {0x30, 0x18, 0x0C, 0x0C, 0x0C, 0x18, 0x30, 0x00}; memcpy(glyph, g, 8); break; }
    case '/': { static const uint8_t g[] = {0x06, 0x0C, 0x18, 0x30, 0x60, 0x00, 0x00, 0x00}; memcpy(glyph, g, 8); break; }
    case '\\': { static const uint8_t g[] = {0x60, 0x30, 0x18, 0x0C, 0x06, 0x00, 0x00, 0x00}; memcpy(glyph, g, 8); break; }
    case '+': { static const uint8_t g[] = {0x00, 0x18, 0x18, 0x7E, 0x18, 0x18, 0x00, 0x00}; memcpy(glyph, g, 8); break; }
    case '=': { static const uint8_t g[] = {0x00, 0x00, 0x7E, 0x00, 0x7E, 0x00, 0x00, 0x00}; memcpy(glyph, g, 8); break; }
    case '#': { static const uint8_t g[] = {0x24, 0x7E, 0x24, 0x24, 0x7E, 0x24, 0x00, 0x00}; memcpy(glyph, g, 8); break; }
    case '*': { static const uint8_t g[] = {0x00, 0x66, 0x3C, 0xFF, 0x3C, 0x66, 0x00, 0x00}; memcpy(glyph, g, 8); break; }
    case '%': { static const uint8_t g[] = {0x62, 0x64, 0x08, 0x10, 0x26, 0x46, 0x00, 0x00}; memcpy(glyph, g, 8); break; }
    case '_': { static const uint8_t g[] = {0x00, 0x00, 0x00, 0x00, 0x00, 0x00, 0xFF, 0x00}; memcpy(glyph, g, 8); break; }
    case ' ': break;
    default: break;
  }
}

/**
 * @brief Retrieve 8x8 Azerbaijani UTF-8 extended characters.
 * @param code Unicode character code point (e.g. 0x0259 for 'ə').
 * @param glyph Output buffer of 8 bytes (8x8 bits).
 */
inline void x5hGetFontGlyph8x8Az(uint16_t code, uint8_t glyph[8]) {
  memset(glyph, 0, 8);
  switch (code) {
    case 0x0259: { static const uint8_t g[] = {0x00, 0x00, 0x3C, 0x06, 0x3E, 0x66, 0x3E, 0x00}; memcpy(glyph, g, 8); break; } // ə
    case 0x011F: { static const uint8_t g[] = {0x0C, 0x00, 0x3E, 0x66, 0x66, 0x3E, 0x06, 0x3C}; memcpy(glyph, g, 8); break; } // ğ
    case 0x0131: { static const uint8_t g[] = {0x00, 0x00, 0x38, 0x18, 0x18, 0x18, 0x3C, 0x00}; memcpy(glyph, g, 8); break; } // ı
    case 0x00F6: { static const uint8_t g[] = {0x24, 0x00, 0x3C, 0x66, 0x66, 0x66, 0x3C, 0x00}; memcpy(glyph, g, 8); break; } // ö
    case 0x00FC: { static const uint8_t g[] = {0x24, 0x00, 0x66, 0x66, 0x66, 0x66, 0x3E, 0x00}; memcpy(glyph, g, 8); break; } // ü
    case 0x00E7: { static const uint8_t g[] = {0x00, 0x00, 0x3C, 0x60, 0x60, 0x60, 0x3C, 0x18}; memcpy(glyph, g, 8); break; } // ç
    case 0x015F: { static const uint8_t g[] = {0x00, 0x00, 0x3E, 0x60, 0x3C, 0x06, 0x7C, 0x18}; memcpy(glyph, g, 8); break; } // ş

    case 0x018F: // Ə
    case 0x04D8: { static const uint8_t g[] = {0x3C, 0x66, 0x60, 0x7C, 0x60, 0x66, 0x3C, 0x00}; memcpy(glyph, g, 8); break; }
    case 0x011E: { static const uint8_t g[] = {0x0C, 0x3C, 0x66, 0x60, 0x6E, 0x66, 0x3C, 0x00}; memcpy(glyph, g, 8); break; } // Ğ
    case 0x0130: { static const uint8_t g[] = {0x18, 0x00, 0x3C, 0x18, 0x18, 0x18, 0x3C, 0x00}; memcpy(glyph, g, 8); break; } // İ
    case 0x00D6: { static const uint8_t g[] = {0x66, 0x3C, 0x66, 0x66, 0x66, 0x66, 0x3C, 0x00}; memcpy(glyph, g, 8); break; } // Ö
    case 0x00DC: { static const uint8_t g[] = {0x66, 0x00, 0x66, 0x66, 0x66, 0x66, 0x3C, 0x00}; memcpy(glyph, g, 8); break; } // Ü
    case 0x00C7: { static const uint8_t g[] = {0x3C, 0x66, 0x60, 0x60, 0x60, 0x66, 0x3C, 0x18}; memcpy(glyph, g, 8); break; } // Ç
    case 0x015E: { static const uint8_t g[] = {0x3C, 0x66, 0x60, 0x3C, 0x06, 0x66, 0x3C, 0x18}; memcpy(glyph, g, 8); break; } // Ş
    default: break;
  }
}

// Backward compatibility alias for 8x8 font getter
inline void x5hGetFontGlyph(char c, uint8_t glyph[8]) { x5hGetFontGlyph8x8(c, glyph); }
inline void x5hGetFontGlyphAz(uint16_t code, uint8_t glyph[8]) { x5hGetFontGlyph8x8Az(code, glyph); }

// ============================================================
// 2. COMPACT 5x7 FONT (Micro receipt text)
// ============================================================

/**
 * @brief Retrieve 5x7 micro bitmap font glyph (stored as 7 bytes).
 */
inline void x5hGetFontGlyph5x7(char c, uint8_t glyph[7]) {
  memset(glyph, 0, 7);
  switch (c) {
    case '0': { static const uint8_t g[] = {0x70, 0x88, 0x98, 0xA8, 0xC8, 0x88, 0x70}; memcpy(glyph, g, 7); break; }
    case '1': { static const uint8_t g[] = {0x20, 0x60, 0x20, 0x20, 0x20, 0x20, 0x70}; memcpy(glyph, g, 7); break; }
    case '2': { static const uint8_t g[] = {0x70, 0x88, 0x08, 0x30, 0x40, 0x80, 0xF8}; memcpy(glyph, g, 7); break; }
    case '3': { static const uint8_t g[] = {0xF8, 0x08, 0x10, 0x30, 0x08, 0x88, 0x70}; memcpy(glyph, g, 7); break; }
    case '4': { static const uint8_t g[] = {0x10, 0x30, 0x50, 0x90, 0xF8, 0x10, 0x10}; memcpy(glyph, g, 7); break; }
    case '5': { static const uint8_t g[] = {0xF8, 0x80, 0xF0, 0x08, 0x08, 0x88, 0x70}; memcpy(glyph, g, 7); break; }
    case '6': { static const uint8_t g[] = {0x30, 0x40, 0x80, 0xF0, 0x88, 0x88, 0x70}; memcpy(glyph, g, 7); break; }
    case '7': { static const uint8_t g[] = {0xF8, 0x08, 0x10, 0x20, 0x40, 0x40, 0x40}; memcpy(glyph, g, 7); break; }
    case '8': { static const uint8_t g[] = {0x70, 0x88, 0x88, 0x70, 0x88, 0x88, 0x70}; memcpy(glyph, g, 7); break; }
    case '9': { static const uint8_t g[] = {0x70, 0x88, 0x88, 0x78, 0x08, 0x10, 0x60}; memcpy(glyph, g, 7); break; }

    case 'A': { static const uint8_t g[] = {0x20, 0x50, 0x88, 0x88, 0xF8, 0x88, 0x88}; memcpy(glyph, g, 7); break; }
    case 'B': { static const uint8_t g[] = {0xF0, 0x88, 0x88, 0xF0, 0x88, 0x88, 0xF0}; memcpy(glyph, g, 7); break; }
    case 'C': { static const uint8_t g[] = {0x70, 0x88, 0x80, 0x80, 0x80, 0x88, 0x70}; memcpy(glyph, g, 7); break; }
    case 'D': { static const uint8_t g[] = {0xE0, 0x90, 0x88, 0x88, 0x88, 0x90, 0xE0}; memcpy(glyph, g, 7); break; }
    case 'E': { static const uint8_t g[] = {0xF8, 0x80, 0x80, 0xF0, 0x80, 0x80, 0xF8}; memcpy(glyph, g, 7); break; }
    case 'F': { static const uint8_t g[] = {0xF8, 0x80, 0x80, 0xF0, 0x80, 0x80, 0x80}; memcpy(glyph, g, 7); break; }
    case 'G': { static const uint8_t g[] = {0x70, 0x88, 0x80, 0x98, 0x88, 0x88, 0x78}; memcpy(glyph, g, 7); break; }
    case 'H': { static const uint8_t g[] = {0x88, 0x88, 0x88, 0xF8, 0x88, 0x88, 0x88}; memcpy(glyph, g, 7); break; }
    case 'I': { static const uint8_t g[] = {0x70, 0x20, 0x20, 0x20, 0x20, 0x20, 0x70}; memcpy(glyph, g, 7); break; }
    case 'J': { static const uint8_t g[] = {0x38, 0x10, 0x10, 0x10, 0x10, 0x90, 0x60}; memcpy(glyph, g, 7); break; }
    case 'K': { static const uint8_t g[] = {0x88, 0x90, 0xA0, 0xC0, 0xA0, 0x90, 0x88}; memcpy(glyph, g, 7); break; }
    case 'L': { static const uint8_t g[] = {0x80, 0x80, 0x80, 0x80, 0x80, 0x80, 0xF8}; memcpy(glyph, g, 7); break; }
    case 'M': { static const uint8_t g[] = {0x88, 0xD8, 0xA8, 0x88, 0x88, 0x88, 0x88}; memcpy(glyph, g, 7); break; }
    case 'N': { static const uint8_t g[] = {0x88, 0xC8, 0xA8, 0x98, 0x88, 0x88, 0x88}; memcpy(glyph, g, 7); break; }
    case 'O': { static const uint8_t g[] = {0x70, 0x88, 0x88, 0x88, 0x88, 0x88, 0x70}; memcpy(glyph, g, 7); break; }
    case 'P': { static const uint8_t g[] = {0xF0, 0x88, 0x88, 0xF0, 0x80, 0x80, 0x80}; memcpy(glyph, g, 7); break; }
    case 'Q': { static const uint8_t g[] = {0x70, 0x88, 0x88, 0x88, 0xA8, 0x90, 0x68}; memcpy(glyph, g, 7); break; }
    case 'R': { static const uint8_t g[] = {0xF0, 0x88, 0x88, 0xF0, 0xA0, 0x90, 0x88}; memcpy(glyph, g, 7); break; }
    case 'S': { static const uint8_t g[] = {0x70, 0x88, 0x80, 0x70, 0x08, 0x88, 0x70}; memcpy(glyph, g, 7); break; }
    case 'T': { static const uint8_t g[] = {0xF8, 0x20, 0x20, 0x20, 0x20, 0x20, 0x20}; memcpy(glyph, g, 7); break; }
    case 'U': { static const uint8_t g[] = {0x88, 0x88, 0x88, 0x88, 0x88, 0x88, 0x70}; memcpy(glyph, g, 7); break; }
    case 'V': { static const uint8_t g[] = {0x88, 0x88, 0x88, 0x88, 0x50, 0x50, 0x20}; memcpy(glyph, g, 7); break; }
    case 'W': { static const uint8_t g[] = {0x88, 0x88, 0x88, 0xA8, 0xA8, 0xD8, 0x88}; memcpy(glyph, g, 7); break; }
    case 'X': { static const uint8_t g[] = {0x88, 0x88, 0x50, 0x20, 0x50, 0x88, 0x88}; memcpy(glyph, g, 7); break; }
    case 'Y': { static const uint8_t g[] = {0x88, 0x88, 0x50, 0x20, 0x20, 0x20, 0x20}; memcpy(glyph, g, 7); break; }
    case 'Z': { static const uint8_t g[] = {0xF8, 0x08, 0x10, 0x20, 0x40, 0x80, 0xF8}; memcpy(glyph, g, 7); break; }

    case 'a': { static const uint8_t g[] = {0x00, 0x00, 0x70, 0x08, 0x78, 0x88, 0x78}; memcpy(glyph, g, 7); break; }
    case 'b': { static const uint8_t g[] = {0x80, 0x80, 0xF0, 0x88, 0x88, 0x88, 0xF0}; memcpy(glyph, g, 7); break; }
    case 'c': { static const uint8_t g[] = {0x00, 0x00, 0x70, 0x88, 0x80, 0x88, 0x70}; memcpy(glyph, g, 7); break; }
    case 'd': { static const uint8_t g[] = {0x08, 0x08, 0x78, 0x88, 0x88, 0x88, 0x78}; memcpy(glyph, g, 7); break; }
    case 'e': { static const uint8_t g[] = {0x00, 0x00, 0x70, 0x88, 0xF8, 0x80, 0x70}; memcpy(glyph, g, 7); break; }
    case 'f': { static const uint8_t g[] = {0x30, 0x48, 0x40, 0xE0, 0x40, 0x40, 0x40}; memcpy(glyph, g, 7); break; }
    case 'g': { static const uint8_t g[] = {0x00, 0x00, 0x78, 0x88, 0x88, 0x78, 0x08, 0x70}; memcpy(glyph, g, 7); break; }
    case 'h': { static const uint8_t g[] = {0x80, 0x80, 0xF0, 0x88, 0x88, 0x88, 0x88}; memcpy(glyph, g, 7); break; }
    case 'i': { static const uint8_t g[] = {0x20, 0x00, 0x60, 0x20, 0x20, 0x20, 0x70}; memcpy(glyph, g, 7); break; }
    case 'j': { static const uint8_t g[] = {0x10, 0x00, 0x30, 0x10, 0x10, 0x90, 0x60}; memcpy(glyph, g, 7); break; }
    case 'k': { static const uint8_t g[] = {0x80, 0x80, 0x90, 0xA0, 0xC0, 0xA0, 0x90}; memcpy(glyph, g, 7); break; }
    case 'l': { static const uint8_t g[] = {0x60, 0x20, 0x20, 0x20, 0x20, 0x20, 0x70}; memcpy(glyph, g, 7); break; }
    case 'm': { static const uint8_t g[] = {0x00, 0x00, 0xD0, 0xA8, 0xA8, 0xA8, 0xA8}; memcpy(glyph, g, 7); break; }
    case 'n': { static const uint8_t g[] = {0x00, 0x00, 0xF0, 0x88, 0x88, 0x88, 0x88}; memcpy(glyph, g, 7); break; }
    case 'o': { static const uint8_t g[] = {0x00, 0x00, 0x70, 0x88, 0x88, 0x88, 0x70}; memcpy(glyph, g, 7); break; }
    case 'p': { static const uint8_t g[] = {0x00, 0x00, 0xF0, 0x88, 0x88, 0xF0, 0x80}; memcpy(glyph, g, 7); break; }
    case 'q': { static const uint8_t g[] = {0x00, 0x00, 0x78, 0x88, 0x88, 0x78, 0x08}; memcpy(glyph, g, 7); break; }
    case 'r': { static const uint8_t g[] = {0x00, 0x00, 0xB0, 0xC8, 0x80, 0x80, 0x80}; memcpy(glyph, g, 7); break; }
    case 's': { static const uint8_t g[] = {0x00, 0x00, 0x78, 0x80, 0x70, 0x08, 0xF0}; memcpy(glyph, g, 7); break; }
    case 't': { static const uint8_t g[] = {0x40, 0x40, 0xE0, 0x40, 0x40, 0x48, 0x30}; memcpy(glyph, g, 7); break; }
    case 'u': { static const uint8_t g[] = {0x00, 0x00, 0x88, 0x88, 0x88, 0x98, 0x68}; memcpy(glyph, g, 7); break; }
    case 'v': { static const uint8_t g[] = {0x00, 0x00, 0x88, 0x88, 0x50, 0x50, 0x20}; memcpy(glyph, g, 7); break; }
    case 'w': { static const uint8_t g[] = {0x00, 0x00, 0x88, 0xA8, 0xA8, 0xD8, 0x88}; memcpy(glyph, g, 7); break; }
    case 'x': { static const uint8_t g[] = {0x00, 0x00, 0x88, 0x50, 0x20, 0x50, 0x88}; memcpy(glyph, g, 7); break; }
    case 'y': { static const uint8_t g[] = {0x00, 0x00, 0x88, 0x88, 0x78, 0x08, 0x70}; memcpy(glyph, g, 7); break; }
    case 'z': { static const uint8_t g[] = {0x00, 0x00, 0xF8, 0x10, 0x20, 0x40, 0xF8}; memcpy(glyph, g, 7); break; }

    case '.': { static const uint8_t g[] = {0x00, 0x00, 0x00, 0x00, 0x00, 0x60, 0x60}; memcpy(glyph, g, 7); break; }
    case ',': { static const uint8_t g[] = {0x00, 0x00, 0x00, 0x00, 0x60, 0x60, 0x40}; memcpy(glyph, g, 7); break; }
    case ':': { static const uint8_t g[] = {0x00, 0x60, 0x60, 0x00, 0x60, 0x60, 0x00}; memcpy(glyph, g, 7); break; }
    case '-': { static const uint8_t g[] = {0x00, 0x00, 0x00, 0xF8, 0x00, 0x00, 0x00}; memcpy(glyph, g, 7); break; }
    case ' ': break;
    default: break;
  }
}

// ============================================================
// 3. MEDIUM 12x16 & LARGE 16x24 FONT PROCEDURAL GENERATORS
// ============================================================

/**
 * @brief Scaled generator for 12x16 font glyph from 8x8 base.
 * @param c ASCII character.
 * @param glyph Output buffer of 24 bytes (12x16 bits).
 */
inline void x5hGetFontGlyph12x16(char c, uint8_t glyph[24]) {
  memset(glyph, 0, 24);
  uint8_t base8[8];
  x5hGetFontGlyph8x8(c, base8);

  for (int r = 0; r < 8; r++) {
    uint8_t rowByte = base8[r];
    uint16_t row12 = 0;
    for (int col = 0; col < 8; col++) {
      if (rowByte & (0x80 >> col)) {
        int col12 = (col * 12) / 8;
        row12 |= (1 << (11 - col12));
        if (col12 + 1 < 12) row12 |= (1 << (11 - (col12 + 1)));
      }
    }
    // Write 2 rows in 16-row high output
    int outRow1 = r * 2;
    int outRow2 = r * 2 + 1;
    glyph[outRow1 * 2] = (row12 >> 4) & 0xFF;
    glyph[outRow1 * 2 + 1] = (row12 << 4) & 0xF0;
    glyph[outRow2 * 2] = (row12 >> 4) & 0xFF;
    glyph[outRow2 * 2 + 1] = (row12 << 4) & 0xF0;
  }
}

/**
 * @brief Scaled generator for 16x24 font glyph from 8x8 base.
 * @param c ASCII character.
 * @param glyph Output buffer of 48 bytes (16x24 bits).
 */
inline void x5hGetFontGlyph16x24(char c, uint8_t glyph[48]) {
  memset(glyph, 0, 48);
  uint8_t base8[8];
  x5hGetFontGlyph8x8(c, base8);

  for (int r = 0; r < 8; r++) {
    uint8_t rowByte = base8[r];
    uint16_t row16 = 0;
    for (int col = 0; col < 8; col++) {
      if (rowByte & (0x80 >> col)) {
        row16 |= (3 << (14 - col * 2));
      }
    }
    // Write 3 rows per input row
    for (int sy = 0; sy < 3; sy++) {
      int outRow = r * 3 + sy;
      glyph[outRow * 2] = (row16 >> 8) & 0xFF;
      glyph[outRow * 2 + 1] = row16 & 0xFF;
    }
  }
}

#endif // TINY_FONTS_H
